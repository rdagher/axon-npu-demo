## CMakeLists.txt
```
# SPDX-License-Identifier: Apache-2.0

cmake_minimum_required(VERSION 3.20.0)

find_package(Zephyr REQUIRED HINTS $ENV{ZEPHYR_BASE})
project(axon_npu_bench)

# AXON_MODEL / AXON_MODEL_DIR: as in ../app. TFLITE: the .tflite the model was compiled from.
zephyr_get(AXON_MODEL)
zephyr_get(AXON_MODEL_DIR)
zephyr_get(TFLITE)
foreach(header ${AXON_MODEL}_.h ${AXON_MODEL}_test_vectors_.h)
  if(NOT EXISTS ${AXON_MODEL_DIR}/nrf_axon_model_${header})
    message(FATAL_ERROR "${AXON_MODEL_DIR}/nrf_axon_model_${header} not found: run `just compile`")
  endif()
endforeach()

target_sources(app PRIVATE src/main.c)
target_include_directories(app PRIVATE ${AXON_MODEL_DIR})
target_compile_definitions(app PRIVATE MODEL_NAME=${AXON_MODEL})

if(CONFIG_BENCH_TFLM)
  if(NOT EXISTS ${TFLITE})
    message(FATAL_ERROR "TFLITE=${TFLITE} not found")
  endif()
  target_sources(app PRIVATE src/tflm.cc)
  set(gen ${ZEPHYR_BINARY_DIR}/include/generated)
  generate_inc_file_for_target(app ${TFLITE} ${gen}/model.tflite.inc)
  target_include_directories(app PRIVATE ${gen})
else()
  target_sources(app PRIVATE src/axon.c)
endif()
```

## Kconfig
```
# SPDX-License-Identifier: Apache-2.0

config BENCH_TFLM
	bool "Run the model on the CPU with TensorFlow Lite Micro instead of the Axon NPU"

config BENCH_TFLM_ARENA_SIZE
	int "TFLM tensor arena, bytes"
	default 131072

config BENCH_TOLERANCE
	int "Largest accepted difference with the expected output, per int8 value"
	default 2

config BENCH_GAP_MS
	int "Sleep between two inferences, ms; 0 keeps the CPU awake for 100 µs instead"
	default 50

source "Kconfig.zephyr"
```

## prj.conf
```kconfig
# SPDX-License-Identifier: Apache-2.0

CONFIG_GPIO=y
# Markers of zephyr-ppk2: D0 is high for one inference.
CONFIG_PPK2_TRACE=y
```

## axon.conf
```kconfig
CONFIG_NRF_AXON=y
CONFIG_NRF_AXON_INTERLAYER_BUFFER_SIZE=52224
```

## quiet.conf
```kconfig
# Measurement build: no UART, so its current stays out of the capture.
CONFIG_SERIAL=n
CONFIG_CONSOLE=n
CONFIG_UART_CONSOLE=n
CONFIG_PRINTK=n
CONFIG_BOOT_BANNER=n
CONFIG_NCS_BOOT_BANNER=n
```

## tflm.conf
```kconfig
CONFIG_BENCH_TFLM=y
CONFIG_CPP=y
CONFIG_STD_CPP17=y
CONFIG_TENSORFLOW_LITE_MICRO=y
CONFIG_TENSORFLOW_LITE_MICRO_CMSIS_NN_KERNELS=y
CONFIG_MAIN_STACK_SIZE=8192
```

## boards/nrf54lm20dk_nrf54lm20b_cpuapp.overlay
```dts
/* SPDX-License-Identifier: Apache-2.0 */

/* P1.12 is free on the DK; wire it to the PPK2's D0. */
/ {
	zephyr,user {
		ppk2-d0-gpios = <&gpio1 12 GPIO_ACTIVE_HIGH>;
	};
};
```

## src/main.c
```c
/* SPDX-License-Identifier: Apache-2.0 */

#include <stdlib.h>

#include <zephyr/kernel.h>
#include <zephyr/sys/printk.h>
#include <zephyr/sys/util.h>

#include <ppk2_trace.h>

#include "backend.h"

/* Inputs and expected outputs come from the compiler's test vectors, for both backends. */
#define CAT_(a, b) a##b
#define CAT(a, b)  CAT_(a, b)
#include STRINGIFY(CAT(CAT(nrf_axon_model_, MODEL_NAME), _test_vectors_.h))
#define INPUTS     CAT(MODEL_NAME, _input_test_vectors)
#define EXPECTED   CAT(MODEL_NAME, _expected_output_vectors)
#define INPUT_LEN  sizeof(CAT(MODEL_NAME, _test_input_vector_0))
#define OUTPUT_LEN sizeof(CAT(MODEL_NAME, _expected_output_vector_0))

PPK2_TRACE_CLAIM(0, infer);

/* The Axon driver pads its output to a multiple of 4 bytes. */
static int8_t out[ROUND_UP(OUTPUT_LEN, 4)] __aligned(4);

int main(void)
{
	int out_len = backend_init();

	if (out_len < (int)OUTPUT_LEN || out_len > (int)sizeof(out)) {
		printk("init failed: %d bytes out, %u expected\n", out_len, (unsigned int)OUTPUT_LEN);
		return -1;
	}
	printk("%s on %s\n", STRINGIFY(MODEL_NAME), IS_ENABLED(CONFIG_BENCH_TFLM) ? "TFLM" : "Axon");

	while (1) {
		for (size_t i = 0; i < ARRAY_SIZE(INPUTS); i++) {
			uint32_t t0 = k_cycle_get_32();
			int err;
			{
				PPK2_TRACE_SCOPE(ppk2_ch_infer);
				err = backend_infer((const int8_t *)INPUTS[i], INPUT_LEN, out);
			}
			uint32_t us = k_cyc_to_us_floor32(k_cycle_get_32() - t0);

			int diff = 0;

			for (size_t j = 0; j < OUTPUT_LEN; j++) {
				diff = MAX(diff, abs(out[j] - ((const int8_t *)EXPECTED[i])[j]));
			}
			printk("vector %zu: %s  %u us  largest difference %d\n", i,
			       err ? "FAILED" : diff ? "differs" : "bit exact", us, diff);
			if (err || diff > CONFIG_BENCH_TOLERANCE) {
				return -1; /* no more markers: a wrong inference is not measured */
			}
			if (CONFIG_BENCH_GAP_MS > 0) {
				k_sleep(K_MSEC(CONFIG_BENCH_GAP_MS));
			} else {
				k_busy_wait(100); /* back to back: awake, with the marker low for 10 samples */
			}
		}
	}
}
```

## src/axon.c
```c
/* SPDX-License-Identifier: Apache-2.0 */

#include <assert.h> /* the model header needs static_assert */

#include <zephyr/sys/util.h>

#include <drivers/axon/nrf_axon_nn_infer.h>
#include <axon/nrf_axon_platform.h>

#include "backend.h"

#define CAT_(a, b) a##b
#define CAT(a, b)  CAT_(a, b)
#include STRINGIFY(CAT(CAT(nrf_axon_model_, MODEL_NAME), _.h))
#define MODEL CAT(model_, MODEL_NAME)

int backend_init(void)
{
	if (nrf_axon_platform_init() != NRF_AXON_RESULT_SUCCESS ||
	    nrf_axon_nn_model_init_vars(&MODEL) != 0 ||
	    nrf_axon_nn_model_validate(&MODEL) != NRF_AXON_RESULT_SUCCESS ||
	    MODEL.input_cnt != 1 || MODEL.output_cnt != 1) {
		return -1;
	}
	return MODEL.outputs[0].packed_size;
}

int backend_infer(const int8_t *in, size_t in_len, int8_t *out)
{
	ARG_UNUSED(in_len);
	return nrf_axon_nn_model_infer_sync(&MODEL, in, out) == NRF_AXON_RESULT_SUCCESS ? 0 : -1;
}
```

## src/backend.h
```c
/* SPDX-License-Identifier: Apache-2.0 */

#include <stddef.h>
#include <stdint.h>

#ifdef __cplusplus
extern "C" {
#endif

/* Returns the size of the model output in bytes, or a negative value. */
int backend_init(void);
int backend_infer(const int8_t *in, size_t in_len, int8_t *out);

#ifdef __cplusplus
}
#endif
```

## src/tflm.cc
```c
/* SPDX-License-Identifier: Apache-2.0 */

#include <string.h>

#include <tensorflow/lite/micro/micro_interpreter.h>
#include <tensorflow/lite/micro/micro_mutable_op_resolver.h>
#include <tensorflow/lite/schema/schema_generated.h>

#include "backend.h"

alignas(16) static const unsigned char model_data[] = {
#include "model.tflite.inc"
};
alignas(16) static uint8_t arena[CONFIG_BENCH_TFLM_ARENA_SIZE];
static tflite::MicroInterpreter *interpreter;

int backend_init(void)
{
	/* The operators of the four MLPerf Tiny reference models. */
	static tflite::MicroMutableOpResolver<7> ops;
	ops.AddConv2D();
	ops.AddDepthwiseConv2D();
	ops.AddFullyConnected();
	ops.AddAveragePool2D();
	ops.AddAdd();
	ops.AddReshape();
	ops.AddSoftmax();

	static tflite::MicroInterpreter instance(tflite::GetModel(model_data), ops, arena, sizeof(arena));
	if (instance.AllocateTensors() != kTfLiteOk) {
		return -1;
	}
	interpreter = &instance;
	return interpreter->output(0)->bytes;
}

int backend_infer(const int8_t *in, size_t in_len, int8_t *out)
{
	TfLiteTensor *input = interpreter->input(0);

	if (input->bytes != in_len) {
		return -1;
	}
	/* The Axon test vectors are channel first; a TFLite image tensor is channel last. */
	const TfLiteIntArray *d = input->dims;
	const int channels = d->size == 4 ? d->data[3] : 1;
	const int pixels = in_len / channels;

	for (int c = 0; c < channels; c++) {
		for (int i = 0; i < pixels; i++) {
			input->data.int8[i * channels + c] = in[c * pixels + i];
		}
	}
	if (interpreter->Invoke() != kTfLiteOk) {
		return -1;
	}
	memcpy(out, interpreter->output(0)->data.int8, interpreter->output(0)->bytes);
	return 0;
}
```
