## CMakeLists.txt
```
# SPDX-License-Identifier: Apache-2.0

cmake_minimum_required(VERSION 3.20.0)

find_package(Zephyr REQUIRED HINTS $ENV{ZEPHYR_BASE})
project(axon_npu_demo)

# Model name, and the directory holding nrf_axon_model_<name>_.h and
# nrf_axon_model_<name>_test_vectors_.h. Default: the add-on's own test models.
# zephyr_get() also finds -DAXON_MODEL=... when it was given to sysbuild.
zephyr_get(AXON_MODEL)
zephyr_get(AXON_MODEL_DIR)
if(NOT AXON_MODEL)
  set(AXON_MODEL tinyml_kws)
endif()
if(NOT AXON_MODEL_DIR)
  set(AXON_MODEL_DIR ${ZEPHYR_EDGE_AI_MODULE_DIR}/tests/axon/compiled_models)
endif()
message(STATUS "Axon model: ${AXON_MODEL} from ${AXON_MODEL_DIR}")

foreach(header ${AXON_MODEL}_.h ${AXON_MODEL}_test_vectors_.h)
  if(NOT EXISTS ${AXON_MODEL_DIR}/nrf_axon_model_${header})
    message(FATAL_ERROR "${AXON_MODEL_DIR}/nrf_axon_model_${header} not found")
  endif()
endforeach()

target_sources(app PRIVATE src/main.c)
target_include_directories(app PRIVATE ${AXON_MODEL_DIR})
target_compile_definitions(app PRIVATE MODEL_NAME=${AXON_MODEL})
```

## prj.conf
```kconfig
# SPDX-License-Identifier: Apache-2.0

CONFIG_NRF_AXON=y

# RAM for activations, also used for the model's input and output. Sized for the largest
# of the four models; each header states its need (NRF_AXON_MODEL_<NAME>_MAX_IL_BUFFER_USED).
CONFIG_NRF_AXON_INTERLAYER_BUFFER_SIZE=52224
```

## boards/nrf54lm20dk_nrf54lm20b_cpuapp.overlay
```dts
/* SPDX-License-Identifier: Apache-2.0 */

&axon {
	status = "okay";
};
```

## src/main.c
```c
/* SPDX-License-Identifier: Apache-2.0 */

#include <assert.h> /* the model header needs static_assert */
#include <string.h>

#include <zephyr/kernel.h>
#include <zephyr/sys/printk.h>
#include <zephyr/sys/util.h>

#include <drivers/axon/nrf_axon_nn_infer.h>
#include <axon/nrf_axon_platform.h>

/* MODEL_NAME comes from CMake, e.g. tinyml_kws. */
#define CAT_(a, b)      a##b
#define CAT(a, b)       CAT_(a, b)
#define HEADER(suffix)  STRINGIFY(CAT(CAT(nrf_axon_model_, MODEL_NAME), suffix))

#include HEADER(_.h)
#include HEADER(_test_vectors_.h)

#define MODEL      CAT(model_, MODEL_NAME)
#define INPUTS     CAT(MODEL_NAME, _input_test_vectors)
#define EXPECTED   CAT(MODEL_NAME, _expected_output_vectors)
#define OUTPUT_LEN sizeof(CAT(MODEL_NAME, _expected_output_vector_0))

/* The driver pads the output to a multiple of 4 bytes. */
static int8_t out[ROUND_UP(OUTPUT_LEN, 4)] __aligned(4);

static void run_vectors(void)
{
	int matches = 0;

	for (size_t i = 0; i < ARRAY_SIZE(INPUTS); i++) {
		uint32_t t0 = k_cycle_get_32();
		nrf_axon_result_e res = nrf_axon_nn_model_infer_sync(&MODEL, INPUTS[i], out);
		uint32_t us = k_cyc_to_us_floor32(k_cycle_get_32() - t0);

		if (res != NRF_AXON_RESULT_SUCCESS) {
			printk("vector %zu: inference failed (%d)\n", i, res);
			continue;
		}

		bool match = memcmp(out, EXPECTED[i], OUTPUT_LEN) == 0;

		matches += match;
		printk("vector %zu: %s  %u us", i, match ? "bit exact" : "MISMATCH", us);
		if (MODEL.labels != NULL) {
			const char *label;
			int16_t class = nrf_axon_nn_get_classification(&MODEL, out, &label, NULL);

			printk("  class %d (%s)", class, label);
		}
		printk("\n");
	}
	printk("%d/%d outputs bit exact\n\n", matches, (int)ARRAY_SIZE(INPUTS));
}

int main(void)
{
	if (nrf_axon_platform_init() != NRF_AXON_RESULT_SUCCESS) {
		printk("axon platform init failed\n");
		return -1;
	}
	if (nrf_axon_nn_model_init_vars(&MODEL) != 0 ||
	    nrf_axon_nn_model_validate(&MODEL) != NRF_AXON_RESULT_SUCCESS) {
		printk("model rejected\n");
		return -1;
	}
	/* out[] holds one output, of the size of the expected vectors. */
	if (MODEL.input_cnt != 1 || MODEL.output_cnt != 1 ||
	    MODEL.outputs[0].packed_size != sizeof(out)) {
		printk("unsupported model: %d inputs, %u outputs, %u bytes out, %u expected\n",
		       MODEL.input_cnt, MODEL.output_cnt,
		       (unsigned int)MODEL.outputs[0].packed_size, (unsigned int)sizeof(out));
		return -1;
	}
	printk("model %s ready: %u bytes out, %u bytes of workspace\n", MODEL.model_name,
	       (unsigned int)OUTPUT_LEN, (unsigned int)MODEL.interlayer_buffer_needed);

	while (1) {
		run_vectors();
		k_sleep(K_SECONDS(2));
	}
}
```
